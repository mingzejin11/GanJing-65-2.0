/* Copyright 2021 mingzejin11
 *
 * This program is free software: you can redistribute it and/or modify
 * it under the terms of the GNU General Public License as published by
 * the Free Software Foundation, either version 2 of the License, or
 * (at your option) any later version.
 *
 * This program is distributed in the hope that it will be useful,
 * but WITHOUT ANY WARRANTY; without even the implied warranty of
 * MERCHANTABILITY or FITNESS FOR A PARTICULAR PURPOSE.  See the
 * GNU General Public License for more details.
 *
 * You should have received a copy of the GNU General Public License
 * along with this program.  If not, see <http://www.gnu.org/licenses/>.
 */

#include "GanJing65.h"
#include "analog.h"
#include <stdio.h>

// Each layer gets a name for readability, which is then used in the keymap matrix below.
// The underscores don't mean anything - you can have a layer called STUFF or any other name.
#define MN 0
#define FN 1

enum GanJing_macros {
	EMAIL = SAFE_RANGE,
	EASTER,
	PASS,
};

char wpm_str[10];

const uint16_t PROGMEM keymaps[][MATRIX_ROWS][MATRIX_COLS] = {
	// Main layer
	[MN] = LAYOUT_hotswap(
		/* esc     1        2        3        4        5        6        7        8        9        0        -        =       bkspc    mute  */
		KC_GESC, KC_1,    KC_2,    KC_3,    KC_4,    KC_5,    KC_6,    KC_7,    KC_8,    KC_9,    KC_0,    KC_MINS, KC_EQL,  KC_BSPC, KC_MUTE,
		/* tab     Q        W        E        R        T        Y        U        I        O        P        [        ]        \      delete */ 
		KC_TAB,  KC_Q,    KC_W,    KC_E,    KC_R,    KC_T,    KC_Y,    KC_U,    KC_I,    KC_O,    KC_P,    KC_LBRC, KC_RBRC, KC_BSLS, KC_DEL,
		/* caps    A        S        D        F        G        H        J        K        L        ;        '        ~       enter     up   */
		KC_CAPS, KC_A,    KC_S,    KC_D,    KC_F,    KC_G,    KC_H,    KC_J,    KC_K,    KC_L,    KC_SCLN, KC_QUOT, KC_NUHS, KC_ENT,  KC_UP,
		/* shift   \        Z        X        C        V        B        N        M        ,        .        /       shift    print   insert */
		KC_LSPO, KC_NUBS, KC_Z,    KC_X,    KC_C,    KC_V,    KC_B,    KC_N,    KC_M,    KC_COMM, KC_DOT,  KC_SLSH, KC_RSPC, KC_PSCR, KC_INS,
		/* ctrl   win      alt               bkspc    enter    space    space     alt      win     ctrl     fn       left     down     right */
		KC_LCTL, KC_LGUI, KC_LALT,          KC_BSPC, KC_ENT,  KC_SPC,  KC_SPC,  KC_RALT, KC_RGUI, KC_RCTL, MO(FN),  KC_LEFT, KC_DOWN, KC_RGHT),

	// Function layer
	[FN] = LAYOUT_hotswap(
		/* esc     F1       F2       F3       F4       F5       F6       F7       F8       F9       F0       F11      F12     bkspc    sleep */
		KC_TRNS, KC_F1,   KC_F2,   KC_F3,   KC_F4,   KC_F5,   KC_F6,   KC_F7,   KC_F8,   KC_F9,   KC_F10,  KC_F11,  KC_F12,  KC_TRNS, KC_SLEP,
		/* tab     Q        W        E      reset      T        Y        U        I        O       pass      [        ]        \       pg up */ 
		KC_TRNS, KC_TRNS, KC_TRNS, KC_TRNS, RESET,   KC_TRNS, KC_TRNS, KC_TRNS, KC_TRNS, KC_TRNS, PASS,    KC_TRNS, KC_TRNS, KC_TRNS, KC_PGUP,
		/* caps    A        S        D        F        G        H      easter     K        L        ;        '        ~       enter     up   */
		KC_TRNS, KC_TRNS, KC_TRNS, KC_TRNS, KC_TRNS, KC_TRNS, KC_TRNS, EASTER,  KC_TRNS, KC_TRNS, KC_TRNS, KC_TRNS, KC_TRNS, KC_TRNS, KC_TRNS,
		/* shift   \        Z        X        C        V        B        N      email      ,        .        /       shift    print    pg dn */
		KC_TRNS, KC_TRNS, KC_TRNS, KC_TRNS, KC_TRNS, KC_TRNS, KC_TRNS, KC_TRNS, EMAIL  , KC_TRNS, KC_TRNS, KC_TRNS, KC_TRNS, KC_TRNS, KC_PGDN,
		/* ctrl   win      alt               bkspc    enter    space    space     alt      win     ctrl      fn      prev     play     next  */
		KC_TRNS, KC_TRNS, KC_TRNS,          KC_TRNS, KC_TRNS, KC_TRNS, KC_TRNS, KC_TRNS, KC_TRNS, KC_TRNS, KC_TRNS, KC_MPRV, KC_MPLY, KC_MNXT)
};

// Encoder function definition
bool encoder_update_user(uint8_t index, bool clockwise) {
	// On function layer, knob controls brightness
	if (IS_LAYER_ON(FN)) {
		if (clockwise) {
			tap_code(KC_BRIU);
		} else {
			tap_code(KC_BRID);
		}

	// Otherwise, knob controls volume by default
	} else {
		if (clockwise) {
			tap_code(KC_VOLU);
		} else {
			tap_code(KC_VOLD);
		}
	}

	return false;
}

// Macro functions
bool process_record_user(uint16_t keycode, keyrecord_t *record) {
	if (record -> event.pressed) {
		switch (keycode) {
			case EMAIL:
				SEND_STRING("mingze.jin11@gmail.com");
				return false;
				break;

			case EASTER:
				SEND_STRING("Mingze is cool");
				return false;
				break;

			case PASS:
				SEND_STRING("blisseyhp714");
				return false;
				break;
			
		}
	}

	return true;
};

// OLED code
// Flips the OLED orientation because the GanJing 70 has it flipped
oled_rotation_t oled_init_user(oled_rotation_t rotation) {
	return OLED_ROTATION_180;
}

// WPM-responsive animation stuff here
// Sleeping parameters
#define SLEEPING_FRAMES 3 				// Number of frames in the animation
#define SLEEPING_SPEED 20 				// Below this WPM value your animation will play sleeping animation

// Running parameters
#define RUNNING_FRAMES 4

// Variables to determine animation frame length
#define ANIM_FRAME_DURATION_MAX 500 	// Longest animation duration in ms
#define ANIM_FRAME_DURATION_MIN 100 	// Shortest animation duration in ms
#define SLEEPING_FRAME_DURATION 500 	// Base value for how long each idle animation will last in ms
#define ANIM_FRAME_RATIO 2.5 			// How aggressively animation speeds up with wpm

// Math to determine the animation duration
#define MAX(x, y) (((x) > (y)) ? (x) : (y))

// Number of bytes in array, minimize for adequate firmware size, max is 1024
#define ANIM_SIZE 1024 					// Number of hex values per image

// Defining other important OLED variables
uint32_t current_animation_duration = 0;// Variable animation duration
uint32_t anim_timer = 0;				// Keeps track of how long animation has run idle
uint32_t anim_sleep = 0;				// Sleep timer
uint8_t current_sleep_frame = 0;		// Current sleeping frame
uint8_t current_running_frame = 0;		// Current running frame

// Amimation frames
static void render_anim(void) {
	// Sleeping frames
	static const char PROGMEM sleep[SLEEPING_FRAMES][ANIM_SIZE] = {
		{ // Sleeping 1
			0x00, 0x00, 0x00, 0x00, 0x00, 0x00, 0x00, 0x00, 0x00, 0x00, 0x00, 0x00, 0x00, 0x00, 0x00, 0x00, 
			0x00, 0x00, 0x00, 0x00, 0x00, 0x00, 0x00, 0x00, 0x00, 0x00, 0x00, 0x00, 0x00, 0x00, 0x00, 0x00, 
			0x00, 0x00, 0x00, 0x00, 0x00, 0x00, 0x00, 0x00, 0x00, 0x00, 0x00, 0x00, 0x00, 0x00, 0x00, 0x00, 
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			0x00, 0x00, 0x00, 0x00, 0x00, 0x00, 0x00, 0x00, 0x00, 0x00, 0x00, 0x00, 0x00, 0x00, 0x00, 0x00
		},

		{ // Sleeping 2
			0x00, 0x00, 0x00, 0x00, 0x00, 0x00, 0x00, 0x00, 0x00, 0x00, 0x00, 0x00, 0x00, 0x00, 0x00, 0x00, 
			0x00, 0x00, 0x00, 0x00, 0x00, 0x00, 0x00, 0x00, 0x00, 0x00, 0x00, 0x00, 0x00, 0x00, 0x00, 0x00, 
			0x00, 0x00, 0x00, 0x00, 0x00, 0x00, 0x00, 0x00, 0x00, 0x00, 0x00, 0x00, 0x00, 0x00, 0x00, 0x00, 
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			0x00, 0x00, 0x00, 0x00, 0x00, 0x00, 0x00, 0x00, 0x00, 0x00, 0x00, 0x00, 0x00, 0x00, 0x00, 0x00
		},

		{ // Sleeping 3
			0x00, 0x00, 0x00, 0x00, 0x00, 0x00, 0x00, 0x00, 0x00, 0x00, 0x00, 0x00, 0x00, 0x00, 0x00, 0x00, 
			0x00, 0x00, 0x00, 0x00, 0x00, 0x00, 0x00, 0x00, 0x00, 0x00, 0x00, 0x00, 0x00, 0x00, 0x00, 0x00, 
			0x00, 0x00, 0x00, 0x00, 0x00, 0x00, 0x00, 0x00, 0x00, 0x00, 0x00, 0x00, 0x00, 0x00, 0x00, 0x00, 
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			0x00, 0x00, 0x00, 0x00, 0x00, 0x00, 0x00, 0x00, 0x00, 0x00, 0x00, 0x00, 0x00, 0x00, 0x00, 0x00 
		},
	};

	// Running frames
	static const char PROGMEM run[RUNNING_FRAMES][ANIM_SIZE] = {
		{ // Running 1
			0x00, 0x00, 0x00, 0x00, 0x00, 0x00, 0x00, 0x00, 0x00, 0x00, 0x00, 0x00, 0x00, 0x00, 0x00, 0x00, 
			0x00, 0x00, 0x00, 0x00, 0x00, 0x0f, 0xff, 0x02, 0x06, 0x06, 0x06, 0x06, 0x0c, 0x0c, 0x0c, 0x0c, 
			0x08, 0x18, 0x18, 0x10, 0x30, 0x30, 0x30, 0x40, 0x40, 0x40, 0x80, 0x80, 0x00, 0x00, 0x00, 0x00, 
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			0x00, 0x00, 0x00, 0x00, 0x00, 0x00, 0x00, 0x00, 0x00, 0x00, 0x00, 0x00, 0x00, 0x00, 0x00, 0x00
		},

		{ // Running 2
			0x00, 0x00, 0x00, 0x00, 0x00, 0x00, 0x00, 0x00, 0x00, 0x00, 0x00, 0x00, 0x00, 0x00, 0x00, 0x00, 
			0x00, 0x00, 0x00, 0xc0, 0x40, 0x40, 0x80, 0x80, 0x80, 0x80, 0x00, 0x00, 0x00, 0x00, 0x00, 0x00, 
			0x00, 0x00, 0x00, 0x00, 0x00, 0x00, 0x00, 0x00, 0x00, 0x00, 0x00, 0x00, 0x00, 0x00, 0x00, 0x00, 
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			0x00, 0x00, 0x00, 0x00, 0x00, 0x00, 0x00, 0x00, 0x00, 0x00, 0x00, 0x00, 0x00, 0x00, 0x00, 0x00
		},

		{ // Running 3
			0x00, 0x00, 0x00, 0x00, 0x00, 0x00, 0x00, 0x00, 0x00, 0x00, 0x00, 0x00, 0x00, 0x00, 0x00, 0x00, 
			0x00, 0x00, 0x00, 0x80, 0x80, 0x00, 0x00, 0x00, 0x00, 0x00, 0x00, 0x00, 0x00, 0x00, 0x00, 0x00, 
			0x00, 0x00, 0x00, 0x00, 0x00, 0x00, 0x00, 0x00, 0x00, 0x00, 0x00, 0x00, 0x00, 0x00, 0x00, 0x00, 
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			0x00, 0x00, 0x00, 0x00, 0x00, 0x00, 0x00, 0x00, 0x00, 0x00, 0x00, 0x00, 0x00, 0x00, 0x00, 0x00
		},

		{ // Running 4
			0x00, 0x00, 0x00, 0x00, 0x00, 0x00, 0x00, 0x00, 0x00, 0x00, 0x00, 0x00, 0x00, 0x00, 0x00, 0x00, 
			0x00, 0x00, 0x00, 0x00, 0x00, 0x00, 0x00, 0x7f, 0xff, 0x01, 0x01, 0x03, 0x02, 0x06, 0x06, 0x04, 
			0x0c, 0x0c, 0x08, 0x18, 0x18, 0x10, 0x30, 0x30, 0x40, 0x40, 0x40, 0xc0, 0x80, 0x80, 0x00, 0x00, 
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			0x00, 0x00, 0x00, 0x00, 0x00, 0x00, 0x00, 0x00, 0x00, 0x00, 0x00, 0x00, 0x00, 0x00, 0x00, 0x00
		},
	};

	// Assumes 1 frame of prep before switching animations
	void animation_phase(void) {
		// Sleeping prep
		if (get_current_wpm() < SLEEPING_SPEED) {
			current_sleep_frame = (current_sleep_frame + 1) % SLEEPING_FRAMES;
			oled_write_raw_P(sleep[abs((SLEEPING_FRAMES - 1) - current_sleep_frame)], ANIM_SIZE);
		}

		// Running prep
		if (get_current_wpm() >= SLEEPING_SPEED) {
			current_running_frame = (current_running_frame + 1) % RUNNING_FRAMES;
			oled_write_raw_P(run[abs((RUNNING_FRAMES - 1) - current_running_frame)], ANIM_SIZE);
		}
	}

	// Variable animation duration
	current_animation_duration = MAX(ANIM_FRAME_DURATION_MIN, (ANIM_FRAME_DURATION_MAX - ANIM_FRAME_RATIO * get_current_wpm()));

	// Code to determine which frame is shown
	// When running animation is displayed
	if (get_current_wpm() > SLEEPING_SPEED) {
		// Turns OLED on
		oled_on();

		// Check if current frame has been displayed long enough
		if (timer_elapsed32(anim_timer) > current_animation_duration) {
			anim_timer = timer_read32();
			animation_phase();
		}

		// Reset sleep timer
		anim_sleep = timer_read32();
	} else {
		// Turns off OLED if sleep timer passes time limit (5 minutes)
		if (timer_elapsed32(anim_sleep) > OLED_TIMEOUT) {
			oled_off();
		} else {
			// Plays sleeping animation at a default 5 fps
			if (timer_elapsed32(anim_timer) > SLEEPING_FRAME_DURATION) {
				anim_timer = timer_read32();
				animation_phase();
			}
		}
	}
}

void oled_task_user(void) {
	render_anim();

	// Prints the current WPM
	oled_set_cursor(13, 1);
	sprintf(wpm_str, "WPM: %03d", get_current_wpm());
	oled_write(wpm_str, false);
}
